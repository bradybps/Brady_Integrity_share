## linux-2.6.28.2/arch/arm/mach-lpc313x/Kconfig
```kconfig
menu "LPC313x Implementations"
	depends on ARCH_LPC313X

choice
	prompt "LPC313x Platform type"
	default MACH_EA313X

config MACH_EA313X
	bool "ea313x board"
	help
	  Say Y here if you are using the Embedded Artist's EA313x board

config MACH_BPS313XV1
	bool "bps313xv1 board"
	help
	  Say Y here if you are using the Brady's BPS313x Version 1.0 board

config MACH_VAL3153
	bool "val3153 board"
	help
	  Say Y here if you are using the NXP val3153 board

config MACH_VAL3154
	bool "val3154 board"
	select LPC3152_AD
	help
	  Say Y here if you are using the NXP val3154 board
	  
endchoice

config LPC3152_AD
	bool

source "kernel/Kconfig.hz"

endmenu
```

## linux-2.6.28.2/drivers/bps/Kconfig
```kconfig
menuconfig BPS_UTILITY
	bool "BPS Utility drivers"
	default n
	---help---
	  Build BPS utility drivers.

if BPS_UTILITY

config BPS_BT_ENABLE
	tristate "BT Enabler"
	depends on ARCH_LPC313X && m
	help
	  Utility driver for enabling BT chips in BPS boards.

config BPS_REBOOT
	tristate "Reboot Module"
	depends on ARCH_LPC313X && m
	help
	  Utility driver for rebooting the BPS board.

config BPS_LED
	tristate "LED Module"
	depends on ARCH_LPC313X && m
	help
	  Module for controlling LEDs in the BPS board.
	  

endif
```

## linux-2.6.28.2/drivers/net/wireless/wl12xx/Kconfig
```kconfig
config WL12XX
	tristate "TI wl12xx support"
	depends on WL12XX_MENU && GENERIC_HARDIRQS
	depends on INET
	select FW_LOADER
	---help---
	  This module adds support for wireless adapters based on TI wl1271 and
	  TI wl1273 chipsets. This module does *not* include support for wl1251.
	  For wl1251 support, use the separate homonymous driver instead.

	  If you choose to build a module, it will be called wl12xx. Say N if
	  unsure.


config WL12XX_SDIO
	tristate "TI wl12xx SDIO support"
	depends on WL12XX && MMC
	---help---
	  This module adds support for the SDIO interface of adapters using
	  TI wl12xx chipsets.  Select this if your platform is using
	  the SDIO bus.

	  If you choose to build a module, it'll be called wl12xx_sdio.
	  Say N if unsure.


config WL12XX_PLATFORM_DATA
	bool
	depends on WL12XX_SDIO != n || WL1251_SDIO != n
	default y
```
